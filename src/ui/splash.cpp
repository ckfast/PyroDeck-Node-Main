#include "splash.h"
#include "config/settings.h"

#include <string.h>

namespace {
const unsigned char epd_bitmap_Pyrodeck_Logo__4_ [] PROGMEM = {
	// 'Pyrodeck Logo (5), 48x48px
	0x00, 0x00, 0x00, 0x00, 0x00, 0x00, 0x00, 0x00, 0x00, 0x00, 0x00, 0x00, 0x00, 0x00, 0x00, 0x00, 
	0xf8, 0x3f, 0x00, 0x00, 0x00, 0xf0, 0xff, 0x3f, 0x00, 0x00, 0x00, 0xe0, 0xff, 0x3f, 0x00, 0x00, 
	0x00, 0xc0, 0xff, 0x3f, 0x00, 0x00, 0x00, 0xc0, 0xff, 0x3f, 0x00, 0x00, 0x00, 0xc0, 0xff, 0x3f, 
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	0x00, 0xff, 0x0f, 0x00, 0x00, 0x00, 0x00, 0xf0, 0x01, 0x00, 0x00, 0x00, 0x00, 0x00, 0x00, 0x00
};
}

SplashScreen::SplashScreen()
    : _startTime(0), _duration(SPLASH_DURATION), _isActive(false)
{
}

void SplashScreen::start(const char* title, const char* subtitle, uint32_t duration) {
    _startTime = millis();
    _duration = duration;
    _isActive = true;
    strncpy(_title, title ? title : "PyroDeck", sizeof(_title) - 1);
    _title[sizeof(_title) - 1] = '\0';
    strncpy(_subtitle, subtitle ? subtitle : "Node", sizeof(_subtitle) - 1);
    _subtitle[sizeof(_subtitle) - 1] = '\0';
}

bool SplashScreen::isActive() const {
    if (!_isActive) return false;
    
    uint32_t elapsed = millis() - _startTime;
    return elapsed < _duration;
}

void SplashScreen::draw(U8G2_SSD1306_128X64_NONAME_F_HW_I2C* display) {
    if (!display) return;
    
    display->clearBuffer();
    
    uint32_t elapsed = millis() - _startTime;
    uint8_t animationPhase = (elapsed / 500) % 4; // 4 phases of animation

    const bool isDefaultStartup = (strcmp(_title, "PyroDeck") == 0) && (strcmp(_subtitle, "Node") == 0);

    if (isDefaultStartup) {
        // Startup splash with centered logo
        display->setDrawColor(1);
        display->setFontMode(0);
        display->setFont(u8g2_font_6x13_tr);
        
        char startupText[32];

        snprintf(
            startupText,
            sizeof(startupText),
            "PyroDeck Node v%s",
            NODE_FIRMWARE_VERSION
        );

        uint8_t titleX = static_cast<uint8_t>((128 - display->getStrWidth(startupText)) / 2);
        
        display->drawStr(titleX, 12, startupText);
        
        // Draw centered 48x48 logo - position adjusted for centering
        // x = (128 - 48) / 2 = 40, y centered in display
        display->drawXBMP(40, 16, 48, 48, epd_bitmap_Pyrodeck_Logo__4_);
        
        // Loading indicator at bottom
        display->setFont(u8g2_font_5x7_tr);
        const char* frames[] = {"|", "/", "-", "\\"};
        char buf[2] = {frames[animationPhase][0], 0};
        display->drawStr(120, 62, buf);
        
        display->sendBuffer();
        return;
    }
    
    // Keep splash content below the 16px header/yellow area.
    display->setFont(u8g2_font_ncenB14_tr);
    display->drawStr(0, 36, _title);
    
    // Subtitle
    display->setFont(u8g2_font_7x13_tr);
    display->drawStr(0, 52, _subtitle);
    
    // Loading animation - rotating dots
    const char* frames[] = {"|", "/", "-", "\\"};
    display->setFont(u8g2_font_5x7_tr);
    char buf[2] = {frames[animationPhase][0], 0};
    display->drawStr(120, 62, buf);
    
    display->sendBuffer();
}

void SplashScreen::stop() {
    _isActive = false;
}
